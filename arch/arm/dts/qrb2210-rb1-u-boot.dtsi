// SPDX-License-Identifier: GPL-2.0

/* This is usually OTG but U-Boot doesn't support that properly */
&usb_dwc3 {
	dr_mode = "host";
};

/* SDHC_2 isn't supported in U-Boot as of now */
&sdhc_2 {
	status = "disabled";
};
